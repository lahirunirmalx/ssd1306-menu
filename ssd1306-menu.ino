 #include <Adafruit_GFX.h>
#include <Adafruit_SSD1306.h>
#include <Arduino.h>
#include <SPI.h>
#include <Wire.h>
#include <OneButton.h>

#define SCREEN_WIDTH 128 // OLED display width, in pixels
#define SCREEN_HEIGHT 64 // OLED display height, in pixels

#define HOME_SCREEN_SIZE 6
#define NUM_ITEMS 11
#define MAX_ITEM_LENGTH 20
#define TOP_MENU_PAD 2




#define PIN_INPUT_OK 16
#define PIN_INPUT_UP 18
#define PIN_INPU_DOWN 19

int currant_screen = 0;
int selected_item = 0;

const unsigned char refreshImage [] PROGMEM = {
	// 'images, 80x80px
	0x00, 0x00, 0x00, 0x00, 0x00, 0x00, 0x00, 0x00, 0x00, 0x00, 0x00, 0x00, 0x00, 0x00, 0x00, 0x00, 
	0x00, 0x00, 0x00, 0x00, 0x00, 0x00, 0x00, 0x00, 0x00, 0x00, 0x00, 0x00, 0x00, 0x00, 0x00, 0x00, 
	0x00, 0x00, 0x00, 0x00, 0x00, 0x00, 0x00, 0x00, 0x00, 0x00, 0x00, 0x00, 0x00, 0x00, 0x00, 0x00, 
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	0x00, 0x00, 0x00, 0x00, 0x00, 0x00, 0x00, 0x00, 0x00, 0x00, 0x00, 0x00, 0x00, 0x00, 0x00, 0x00
};

char main_menu_items[NUM_ITEMS][MAX_ITEM_LENGTH] = {
    {"New File"},
    {"Open File"},
    {"Save"},
    {"Save As"},
    {"Undo"},
    {"Redo"},
    {"Sensor"},
    {"Key Lock"},
    {"Settings"},
    {"Network"},
    {"Close"}
};


int num_rows = sizeof(main_menu_items) / sizeof(main_menu_items[0]);
// Declaration for an SSD1306 display connected to I2C (SDA, SCL pins)
#define OLED_RESET     -1 // Reset pin # (or -1 if sharing Arduino reset pin)
Adafruit_SSD1306 display(SCREEN_WIDTH, SCREEN_HEIGHT, &Wire, OLED_RESET);

OneButton button_ok(PIN_INPUT_OK, true);
OneButton button_up(PIN_INPUT_UP, true);
OneButton button_down(PIN_INPU_DOWN, true);

void goUp() {
  selected_item = (selected_item > 0) ? selected_item - 1 : 0;
}

void goDown() {
  selected_item = (selected_item < num_rows - 1) ? selected_item + 1 : num_rows - 1;
}

void goTop(){
selected_item = 0;
}
void goBottom(){
selected_item = num_rows-1;
}

void clickOk(){
  static  char menuName[10];
  snprintf(menuName,10, "%-18s", main_menu_items[selected_item]);
  switch (selected_item)
  {
  case 10: {
  display.clearDisplay(); 
  display.setTextSize(1);
  display.setTextColor( WHITE);
  display.setCursor(0, 20);
  display.print("Closing .");
  display.display(); 
  delay(250);
  for (int i = 0 ; i < 5; i++)
  { 
    display.print(" .");
    delay(100);
    display.display(); 
  }
  display.clearDisplay(); 
  display.display(); 
   delay(500);
   break;
  
  } 
  default:{
  printMenuTitle(menuName);
  display.drawBitmap(20, 1, refreshImage, 80, 80, WHITE);
  display.display(); 
  break;
  }
  
  
  }
 delay(2500);
  
}

void printMenu(int index,const char* top_menu,char menu_items[][MAX_ITEM_LENGTH] ,int num_rows){

int max_menu_index = HOME_SCREEN_SIZE + ((index >= HOME_SCREEN_SIZE) ? (index - TOP_MENU_PAD) : 0);
int top_pad = (max_menu_index > num_rows) ? (num_rows - HOME_SCREEN_SIZE) : ((index >= HOME_SCREEN_SIZE) ? (index - TOP_MENU_PAD) : 0);

printMenuTitle(top_menu);
printActionMenu(top_pad, max_menu_index, menu_items);
display.display();
}

void printActionMenu(int top_pad, int max_menu_index, char menu_items[][20]) { 
  static char menuName[22];

  for (int i = top_pad; i < max_menu_index; i++) {
    display.setTextColor(i == selected_item ? BLACK : WHITE, WHITE);
    menuName[0] = (i == selected_item) ? '>' : ' ';
    menuName[1] =   ' ';
    
    snprintf(menuName + 2, sizeof(menuName) - 2, "%-18s", menu_items[i]);
    display.println(menuName);
  }
}

void trim_string(char *str, const char *org, int length) {
  strcpy(str, org);
  if (strlen(org) > length) {
    str[length] = '\0'; // Null-terminate the string at the desired length
  }
}

void printMenuTitle(const char *top_menu) {
  display.clearDisplay();
  display.setTextSize(2);
  display.setTextColor(BLACK, WHITE);
  display.setCursor(0, 0);
  static char menuName1[8] = "";
  trim_string(menuName1,top_menu,8);
  static char menuName[10] = "";
  sprintf(menuName, "< %-8s", F(menuName1));
  display.println(menuName);
  display.setTextSize(1);
  display.setTextColor(WHITE);
  
}
void loop() {
  
 printMenu(selected_item,"Home",main_menu_items,num_rows);
 button_up.tick();
 button_down.tick();  
 button_ok.tick();
}

void setup() {
  Serial.begin(115200);

  if(!display.begin(SSD1306_SWITCHCAPVCC, 0x3C)) { // Address 0x3D for 128x64
    Serial.println(F("SSD1306 allocation failed"));
    for(;;);
  }
  button_up.attachClick(goUp);  
  button_down.attachClick(goDown); 
  button_ok.attachClick(clickOk); 

  button_up.attachDoubleClick(goTop);
  button_down.attachDoubleClick(goBottom);  
  //button_ok.attachDoubleClick(goHome); 

  delay(500);
  printMenu(0,"Home",main_menu_items,num_rows);
}

